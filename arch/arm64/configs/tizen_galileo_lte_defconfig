## arch/arm64/configs/tizen_galileo_lte_defconfig
```kconfig
CONFIG_GALILEO_LTE=y
CONFIG_MCU_IPC=y
CONFIG_SHM_IPC=y
CONFIG_SEC_SIPC_MODEM_IF=y
```

## drivers/sensorhub/Kconfig
```kconfig
menu "Sensor HUB Drivers"

#
# sensor drivers configuration
#

source "drivers/sensorhub/brcm/Kconfig"
source "drivers/sensorhub/brcm_pulse/Kconfig"
endmenu
```
